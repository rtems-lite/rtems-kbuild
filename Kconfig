## Kconfig
```kconfig
#
# For a description of the syntax of this configuration file,
# see Documentation/kbuild/kconfig-language.txt.
#
mainmenu "RTEMS/$ARCH $KERNELVERSION Kernel Configuration"

config SRCARCH
	string
	option env="SRCARCH"

# source "arch/$SRCARCH/Kconfig"
source "c/src/lib/libcpu/$SRCARCH/Kconfig"
```
